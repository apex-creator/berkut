/**
 * @cliArgs --device "XWRL14XX" --package "FCCSP" --part "Default" --context "m4fss0-0" --product "MMWAVE-L-SDK@05.00.00"
 * @versions {"tool":"1.15.0+2826"}
 */

/**
 * Import the modules used in this configuration.
 */
const crc        = scripting.addModule("/drivers/crc/crc", {}, false);
const crc1       = crc.addInstance();
const gpio       = scripting.addModule("/drivers/gpio/gpio", {}, false);
const gpio1      = gpio.addInstance();
const mcspi      = scripting.addModule("/drivers/mcspi/mcspi", {}, false);
const mcspi1     = mcspi.addInstance();
const mpu_armv7  = scripting.addModule("/kernel/dpl/mpu_armv7", {}, false);
const mpu_armv71 = mpu_armv7.addInstance();
const mpu_armv72 = mpu_armv7.addInstance();
const mpu_armv73 = mpu_armv7.addInstance();

/**
 * Write custom configuration values to the imported modules.
 */
crc1.$name = "CONFIG_CRC0";

gpio1.$name                = "SPI_BUSY";
gpio1.GPIO.gpioPin.$assign = "ball.J10";

mcspi1.$name                   = "CONFIG_MCSPI0";
mcspi1.intrEnable              = "POLLED";
mcspi1.MCSPI.$assign           = "MCSPIA";
mcspi1.mcspiChannel[0].$name   = "CONFIG_MCSPI_CH0";
mcspi1.mcspiChannel[0].bitRate = 22000000;

mpu_armv71.$name        = "CONFIG_MPU_REGION0";
mpu_armv71.attributes   = "Device";
mpu_armv71.allowExecute = false;

mpu_armv72.$name    = "CONFIG_MPU_REGION1";
mpu_armv72.baseAddr = 0x400000;
mpu_armv72.size     = 19;

mpu_armv73.$name    = "CONFIG_MPU_REGION2";
mpu_armv73.baseAddr = 0x22400000;
mpu_armv73.size     = 19;

/**
 * Pinmux solution for unlocked pins/peripherals. This ensures that minor changes to the automatic solver in a future
 * version of the tool will not impact the pinmux you originally saw.  These lines can be completely deleted in order to
 * re-solve from scratch.
 */
gpio1.GPIO.$suggestSolution                 = "GPIO";
mcspi1.MCSPI.CLK.$suggestSolution           = "ball.D10";
mcspi1.MCSPI.MOSI.$suggestSolution          = "ball.B12";
mcspi1.MCSPI.MISO.$suggestSolution          = "ball.C11";
mcspi1.mcspiChannel[0].CSn.$suggestSolution = "ball.D11";
